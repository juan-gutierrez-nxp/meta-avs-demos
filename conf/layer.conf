## conf/layer.conf
```bitbake
# We have a conf and classes directory, add to BBPATH
BBPATH .= ":${LAYERDIR}"

# We have recipes-* directories, add to BBFILES
BBFILES += "${LAYERDIR}/recipes-*/*/*.bb \
	${LAYERDIR}/recipes-*/*/*.bbappend"

BBFILE_COLLECTIONS += "avs-demos"
BBFILE_PATTERN_avs-demos = "^${LAYERDIR}/"
BBFILE_PRIORITY_avs-demos = "16"

# Additional license directories.
LICENSE_PATH += "${LAYERDIR}/custom-licenses"
```

## conf/machine/imx7d-pico.conf
```bitbake
#@TYPE: Machine
#@NAME: TechNexion i.MX7D PICO HOBBIT BOARD
#@SOC: i.MX7D
#@DESCRIPTION: Machine configuration for TechNexion i.MX7D PICO PI BOARD
#@MAINTAINER: Juan Gutierrez <juan.gutierrez@nxp.com>

require conf/machine/include/imx-picopi-base.inc
require conf/machine/include/tune-cortexa7.inc

MACHINEOVERRIDES =. "mx7:mx7d:"
SOC_FAMILY = "mx7:mx7d:"

KERNEL_DEVICETREE ?= "imx7d-pico_pi.dtb"
SPL_BINARY = "SPL"
UBOOT_SUFFIX = "img"
UBOOT_MAKE_TARGET = "all"
UBOOT_CONFIG ??= "sd"
UBOOT_CONFIG[sd] = "pico-imx7d_spl_defconfig"
UBOOT_CONFIG[mfgtool] = "pico-imx7d_spl_defconfig"

XSERVER += "mesa-driver-swrast"


SERIAL_CONSOLE = "115200 ttymxc4"
```

## meta-avs-dspc/conf/layer.conf
```bitbake
# We have a conf and classes directory, add to BBPATH
BBPATH .= ":${LAYERDIR}"

# We have recipes-* directories, add to BBFILES
BBFILES += "${LAYERDIR}/recipes-*/*/*.bb \
	${LAYERDIR}/recipes-*/*/*.bbappend"

BBFILE_COLLECTIONS += "avs-dspc"
BBFILE_PATTERN_avs-dspc = "^${LAYERDIR}/"
BBFILE_PRIORITY_avs-dspc = "16"

# Additional license directories.
LICENSE_PATH += "${LAYERDIR}/custom-licenses"
```
